## drivers/tm-driver/Kconfig
```kconfig
#
# TM-DRIVERS TUTORIAL
#

menu "tm-driver-tutorial"

source "drivers/tm-driver/gpio-tutorial/Kconfig"
source "drivers/tm-driver/ads1115-custom/Kconfig"
source "drivers/tm-driver/usb-custom/Kconfig"
endmenu
```

## drivers/tm-driver/acdc-i2c-tutorial/Kconfig
```kconfig
config ACDC_I2C_TM_DRIVER
	bool "Custom ACDC i2c Drivers Support for ads1115"
	help
	  Custom ACDC i2c Drivers Support for ads1115
```

## drivers/tm-driver/ads1115-custom/Kconfig
```kconfig
#
# ADC EXAMPLE DRIVER
#


config ADC_CUSTOM_TM_DRIVER
	bool "Custom ADC Drivers Support"
	help
	  Custom ADC Drivers Support
```

## drivers/tm-driver/gpio-tutorial/Kconfig
```kconfig
#
# GPIO EXAMPLE DRIVER
#


config GPIO_TM_DRIVER
	bool "Custom GPIO Drivers Support"
	help
	  Custom GPIO Drivers Support
```

## drivers/tm-driver/usb-custom/Kconfig
```kconfig
#
# USB EXAMPLE DRIVER
#

config USB_CUSTOM_TM_DRIVER
	bool "Custom USB Drivers Support"
	help
	  Custom USB Drivers Support
```
